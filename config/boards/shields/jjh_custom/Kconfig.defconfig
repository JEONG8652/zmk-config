## config/boards/shields/jjh_custom/Kconfig.defconfig
```kconfig
if SHIELD_JJH_CUSTOM_LEFT

config ZMK_KEYBOARD_NAME
    default "JJH Custom 48"

config ZMK_SPLIT_ROLE_CENTRAL
    default y

endif

if SHIELD_JJH_CUSTOM_RIGHT

config ZMK_KEYBOARD_NAME
    default "JJH Custom 48 R"

endif

if SHIELD_JJH_CUSTOM_LEFT || SHIELD_JJH_CUSTOM_RIGHT

config ZMK_SPLIT
    default y

endif
```

## config/boards/shields/jjh_custom/Kconfig.shield
```kconfig
# Copyright (c) 2020 Pete Johanson
# SPDX-License-Identifier: MIT

config SHIELD_JJH_CUSTOM_LEFT
    def_bool $(shields_list_contains,jjh_custom_left)

config SHIELD_JJH_CUSTOM_RIGHT
    def_bool $(shields_list_contains,jjh_custom_right)
```
